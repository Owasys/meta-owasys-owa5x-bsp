## conf/distro/owa5.conf
```bitbake
# Distro for owa5x
require conf/distro/include/fslc-base.inc

# Switch to Debian packaging and include package-management in the image
PACKAGE_CLASSES = "package_deb"
EXTRA_IMAGE_FEATURES += "package-management"

DISTRO = "owa5"
DISTRO_NAME = "owa5"
DISTRO_CODENAME ="owa5"
DISTRO_VERSION = "1.1.0"

# Remove conflicting backends
DISTRO_FEATURES:remove = " wayland directfb x11"
DISTRO_FEATURES:append = " pam systemd virtualization rauc tpm "
VIRTUAL-RUNTIME_init_manager = "systemd"
MACHINEOVERRIDES =. "imx-generic-bsp"
```

## wic/owa5-bootable-usd.wks
```
# short-description: Create SD card image for owa5x
# long-description: Create SD card image for owa5x that boots and flashes the nand of the device with the ubi of the owa5-image-nand receipe.
# Boot files are located in the first vfat partition.

part /boot --source bootimg-partition --ondisk mmcblk0 --fstype=vfat --label boot --active --align 4 --fixed-size 32 --sourceparams="loader=u-boot" --use-uuid
part / --source rootfs --ondisk mmcblk0 --fstype=ext4 --label root --align 4 --use-uuid
bootloader --append="console=ttyS0,115200"
```
